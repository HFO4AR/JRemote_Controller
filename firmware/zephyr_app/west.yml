## firmware/zephyr_app/west.yml
```yaml
# JRemote Controller - Zephyr Firmware
# Target: ESP32

manifest:
  self:
    west-commands: scripts/west-commands.yml

  remotes:
    - name: zephyrproject-rtos
      url-base: https://github.com/zephyrproject-rtos

  projects:
    - name: zephyr
      remote: zephyrproject-rtos
      revision: v4.2.0
      import:
        name-allowlist:
          - hal_espressif
```
